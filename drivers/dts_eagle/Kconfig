## drivers/dts_eagle/Kconfig
```kconfig
config AINUR_DTS_SW
	bool "Ainur DTS software driver"
	depends on ARM
	default n if ARM
	help
	  Driver port of DTS' android audio software-processed
	  effect, which can be built side-by-side along with
	  the hardware-processed effect driver.
```
